/dts-v1/;
/plugin/;
/*
reference :
https://github.com/fivdi/onoff/wiki/Enabling-Pullup-and-Pulldown-Resistors-on-The-Raspberry-Pi

This overlay is being contructed to drive a dual sensor solenoid (aircylinder)
The input sensor pins need to be pulldown

*/

/ {
    compatible = "brcm,bcm2708";
    fragment@0 {
        target = <&gpio>;
        __overlay__ {
            pinctrl-names = "default";
            pinctrl-0 = <&my_pins>;

            my_pins: my_pins {
                brcm,pins = <13 19 26>;     /* gpio no. */
                brcm,function = <0 0 1>; /* 0:in, 1:out */
                brcm,pull = <2 2 0>;     /* 2:up 1:down 0:none */
            };
        };
    };
};
